## drivers/input/touchscreen/mediatek/ST14348/Kconfig
```kconfig
#
# Touchscreen driver configuration
#
config TOUCHSCREEN_MTK_ST14348_TS
    bool "Focaltech Ts for Mediatek"
    depends on I2C
    default n
    help
      Say Y here if you have Stironix  touch panel.
      If unsure, say N.
```

## drivers/misc/mediatek/rtc/Kconfig
```kconfig
# RTC Related
config MTK_RTC
	bool "MediaTek Real Time Clock Support"
	default n
	help
	  A real-time clock (RTC) is a computer
	  clock (most often in the form of an
	  integrated circuit) that keeps track
	  of the current time.

config FIH_FIRST_BOOT_SUPPORT
	bool "FIH FIRST BOOT Support"
	default n
	help
	  Fih first boot support for speed up 
	  the first power on.

config FIH_FIRST_BOOT_BITS
	hex "FIH FIRST BOOT BITS OFFEST"
	default 0x11
	depends on FIH_FIRST_BOOT_SUPPORT
        help
          Fih first boot SPAR0 bits offset.
```

## drivers/misc/mediatek/sensors-1.0/accelerometer/stk8baxx/Kconfig
```kconfig
config STK8BAXX
	bool "stk8baxx_driver"
	default n
	help
	  If this option is set, it will support
	  stk8baxx Accelerometer.
```
